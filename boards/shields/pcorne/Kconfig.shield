## boards/shields/pcorne/Kconfig.shield
```kconfig
# Copyright (c) 2020 Pete Johanson
# SPDX-License-Identifier: MIT

config SHIELD_PCORNE_LEFT
    def_bool $(shields_list_contains,pcorne_left)

config SHIELD_PCORNE_RIGHT
    def_bool $(shields_list_contains,pcorne_right)
```
